## configs/orangepi-5-plus-rk3588_defconfig
```kconfig
CONFIG_ARM=y
CONFIG_SKIP_LOWLEVEL_INIT=y
CONFIG_SYS_HAS_NONCACHED_MEMORY=y
CONFIG_COUNTER_FREQUENCY=24000000
CONFIG_ARCH_ROCKCHIP=y
CONFIG_SF_DEFAULT_SPEED=24000000
CONFIG_SF_DEFAULT_MODE=0x2000
CONFIG_DEFAULT_DEVICE_TREE="rockchip/rk3588-orangepi-5-plus"
CONFIG_ROCKCHIP_RK3588=y
CONFIG_ROCKCHIP_SPI_IMAGE=y
CONFIG_SPL_SERIAL=y
CONFIG_TARGET_EVB_RK3588=y
CONFIG_DEBUG_UART_BASE=0xFEB50000
CONFIG_DEBUG_UART_CLOCK=24000000
CONFIG_SPL_SPI_FLASH_SUPPORT=y
CONFIG_SPL_SPI=y
CONFIG_SYS_LOAD_ADDR=0xc00800
CONFIG_PCI=y
CONFIG_DEBUG_UART=y
CONFIG_AHCI=y
CONFIG_FIT=y
CONFIG_FIT_VERBOSE=y
CONFIG_SPL_FIT_SIGNATURE=y
CONFIG_SPL_LOAD_FIT=y
CONFIG_LEGACY_IMAGE_FORMAT=y
CONFIG_DEFAULT_FDT_FILE="rockchip/rk3588-orangepi-5-plus.dtb"
# CONFIG_DISPLAY_CPUINFO is not set
CONFIG_DISPLAY_BOARDINFO_LATE=y
CONFIG_SPL_MAX_SIZE=0x40000
CONFIG_SPL_PAD_TO=0x7f8000
# CONFIG_SPL_RAW_IMAGE_SUPPORT is not set
CONFIG_SPL_SPI_LOAD=y
CONFIG_SYS_SPI_U_BOOT_OFFS=0x60000
CONFIG_SPL_ATF=y
CONFIG_CMD_GPIO=y
CONFIG_CMD_GPT=y
CONFIG_CMD_I2C=y
CONFIG_CMD_MMC=y
CONFIG_CMD_PCI=y
CONFIG_CMD_USB=y
# CONFIG_CMD_SETEXPR is not set
CONFIG_CMD_REGULATOR=y
# CONFIG_SPL_DOS_PARTITION is not set
CONFIG_SPL_OF_CONTROL=y
CONFIG_OF_LIVE=y
CONFIG_OF_SPL_REMOVE_PROPS="clock-names interrupt-parent assigned-clocks assigned-clock-rates assigned-clock-parents"
CONFIG_SPL_DM_SEQ_ALIAS=y
CONFIG_SPL_REGMAP=y
CONFIG_SPL_SYSCON=y
CONFIG_AHCI_PCI=y
CONFIG_DWC_AHCI=y
CONFIG_SPL_CLK=y
CONFIG_ROCKCHIP_GPIO=y
CONFIG_SYS_I2C_ROCKCHIP=y
CONFIG_MISC=y
CONFIG_SUPPORT_EMMC_RPMB=y
CONFIG_MMC_DW=y
CONFIG_MMC_DW_ROCKCHIP=y
CONFIG_MMC_SDHCI=y
CONFIG_MMC_SDHCI_SDMA=y
CONFIG_MMC_SDHCI_ROCKCHIP=y
CONFIG_SF_DEFAULT_BUS=5
CONFIG_SPI_FLASH_SFDP_SUPPORT=y
CONFIG_SPI_FLASH_XMC=y
CONFIG_PHYLIB=y
CONFIG_RTL8169=y
CONFIG_NVME_PCI=y
CONFIG_PCIE_DW_ROCKCHIP=y
CONFIG_PHY_ROCKCHIP_INNO_USB2=y
CONFIG_PHY_ROCKCHIP_NANENG_COMBOPHY=y
CONFIG_PHY_ROCKCHIP_USBDP=y
CONFIG_SPL_PINCTRL=y
CONFIG_PWM_ROCKCHIP=y
CONFIG_SPL_RAM=y
CONFIG_SCSI=y
CONFIG_BAUDRATE=1500000
CONFIG_DEBUG_UART_SHIFT=2
CONFIG_SYS_NS16550_MEM32=y
CONFIG_ROCKCHIP_SFC=y
CONFIG_SYSRESET=y
CONFIG_USB=y
CONFIG_USB_XHCI_HCD=y
CONFIG_USB_EHCI_HCD=y
CONFIG_USB_EHCI_GENERIC=y
CONFIG_USB_OHCI_HCD=y
CONFIG_USB_OHCI_GENERIC=y
CONFIG_USB_DWC3=y
CONFIG_USB_DWC3_GENERIC=y
CONFIG_ERRNO_STR=y

CONFIG_CMD_BOOTMENU=y
CONFIG_CMD_SYSBOOT=y
#CONFIG_CMD_DEKBLOB=y
#CONFIG_CMD_HDMIDETECT=y
CONFIG_CMD_BDINFO_EXTRA=y
CONFIG_CMD_CONFIG=y
#CONFIG_CMD_HISTORY=y
#CONFIG_CMD_LICENSE=y
#CONFIG_CMD_PMC=y
#CONFIG_CMD_SMBIOS=y
CONFIG_CMD_BOOTZ=y
#CONFIG_CMD_BOOTEFI_HELLO=y
#CONFIG_CMD_BOOTEFI_SELFTEST=y
#CONFIG_CMD_ADTIMG=y
#CONFIG_CMD_ELF_FDT_SETUP=y
CONFIG_CMD_SPL=y
#CONFIG_CMD_ASKENV=y
CONFIG_CMD_GREPENV=y
#CONFIG_CMD_ERASEENV=y
#CONFIG_CMD_ENV_CALLBACK=y
#CONFIG_CMD_ENV_FLAGS=y
#CONFIG_CMD_NVEDIT_EFI=y
#CONFIG_CMD_NVEDIT_INDIRECT=y
#CONFIG_CMD_NVEDIT_INFO=y
#CONFIG_CMD_NVEDIT_LOAD=y
#CONFIG_CMD_NVEDIT_SELECT=y
CONFIG_CMD_BINOP=y
#CONFIG_CMD_EEPROM=y
CONFIG_CMD_MD5SUM=y
CONFIG_CMD_MEMINFO=y
CONFIG_CMD_MEM_SEARCH=y
#CONFIG_CMD_MX_CYCLIC=y
CONFIG_CMD_MEMTEST=y
CONFIG_CMD_SHA1SUM=y
CONFIG_CMD_STRINGS=y
CONFIG_CMD_ZIP=y
CONFIG_CMD_ADC=y
CONFIG_CMD_BCB=y
CONFIG_CMD_BIND=y
CONFIG_CMD_CLK=y
#CONFIG_CMD_DEMO=y
CONFIG_CMD_DFU=y
#CONFIG_CMD_FUSE=y
CONFIG_CMD_GPIO_READ=y
CONFIG_CMD_PWM=y
CONFIG_CMD_GPT_RENAME=y
#CONFIG_CMD_IDE=y
#CONFIG_CMD_IO=y
#CONFIG_CMD_IOTRACE=y
CONFIG_CMD_LOADM=y
CONFIG_CMD_SAVES=y
CONFIG_CMD_LSBLK=y
CONFIG_CMD_MBR=y
CONFIG_CMD_MISC=y
#CONFIG_CMD_BKOPS_ENABLE=y
#CONFIG_CMD_MMC_REG=y
#CONFIG_CMD_MMC_SWRITE=y
#CONFIG_CMD_CLONE=y
CONFIG_CMD_MTD=y
#CONFIG_CMD_ONENAND=y
#CONFIG_CMD_OSD=y
CONFIG_CMD_PCI_MPS=y
CONFIG_CMD_POWEROFF=y
CONFIG_CMD_READ=y
#CONFIG_CMD_SATA=y
CONFIG_CMD_SDRAM=y
#CONFIG_CMD_SF_TEST=y
CONFIG_CMD_SPI=y
#CONFIG_CMD_USB_SDP=y
#CONFIG_CMD_RKMTD=y
#CONFIG_CMD_WRITE=y
CONFIG_CMD_CAT=y
CONFIG_CMD_SETEXPR=y
CONFIG_CMD_XXD=y
CONFIG_CMD_PCAP=y
CONFIG_CMD_TFTPPUT=y
CONFIG_CMD_TFTPSRV=y
CONFIG_CMD_RARP=y
CONFIG_CMD_NFS=y
CONFIG_CMD_WGET=y
CONFIG_CMD_CDP=y
CONFIG_CMD_SNTP=y
CONFIG_CMD_DNS=y
CONFIG_CMD_LINK_LOCAL=y
CONFIG_CMD_ETHSW=y
CONFIG_CMD_WOL=y
#CONFIG_CMD_2048=y
CONFIG_CMD_BSP=y
#CONFIG_CMD_CACHE=y
#CONFIG_CMD_CONITRACE=y
CONFIG_CMD_CLS=y
#CONFIG_CMD_EFIDEBUG=y
#CONFIG_CMD_EXCEPTION=y
#CONFIG_CMD_INI=y

#CONFIG_DM_RTC=y
#CONFIG_CMD_DATE=y

CONFIG_CMD_TIME=y
CONFIG_CMD_GETTIME=y
CONFIG_CMD_PAUSE=y
CONFIG_CMD_RNG=y
#CONFIG_CMD_KASLRSEED=y
CONFIG_CMD_TIMER=y
#CONFIG_CMD_QFW=y
#CONFIG_CMD_PSTORE=y
#CONFIG_CMD_TERMINAL=y
CONFIG_CMD_UUID=y
#CONFIG_CMD_AES=y
#CONFIG_CMD_BLOB=y
#CONFIG_CMD_HASH=y
#CONFIG_CMD_HVC=y
#CONFIG_CMD_SMC=y
#CONFIG_CMD_SCMI=y
#CONFIG_CMD_BTRFS=y
#CONFIG_CMD_EROFS=y
#CONFIG_CMD_EXT4_WRITE=y
CONFIG_CMD_SQUASHFS=y
CONFIG_CMD_FS_UUID=y
#CONFIG_CMD_JFFS2=y
CONFIG_CMD_MTDPARTS=y
CONFIG_CMD_ZFS=y
#CONFIG_CMD_DIAG=y
#CONFIG_CMD_EVENT=y
CONFIG_CMD_LOG=y
#CONFIG_CMD_UBI=y
#CONFIG_CMD_PCA953X=y
#CONFIG_CMD_DHRYSTONE=y
```
